//============================================================================//
//            G L O B A L   D E F I N I T I O N S                             //
//============================================================================//
#include "basis/sdhDebug.h"
#include "sdhDef.h"
#include "basis/sdhError.h"

#include "dev_lcd.h"
#include "dev_id.h"

//#include "dev_lcd
#include "dev_lcd/FM12864/dev_lcd_fm12864.h"

//------------------------------------------------------------------------------
// const defines
//------------------------------------------------------------------------------

//------------------------------------------------------------------------------
// module global vars
//------------------------------------------------------------------------------


//------------------------------------------------------------------------------
// global function prototypes
//------------------------------------------------------------------------------

//============================================================================//
//            P R I V A T E   D E F I N I T I O N S                           //
//============================================================================//

//------------------------------------------------------------------------------
// const defines
//------------------------------------------------------------------------------

//------------------------------------------------------------------------------
// local types
//------------------------------------------------------------------------------

//------------------------------------------------------------------------------
// local vars
//------------------------------------------------------------------------------
static dev_lcd	*sington_lcd;

//------------------------------------------------------------------------------
// local function prototypes
//------------------------------------------------------------------------------



//============================================================================//
//            P U B L I C   F U N C T I O N S                                 //
//============================================================================//


int Open_dev_lcd(int major, int minor, void **dev)
{
	int ret = 0;
	
	*dev = NULL;
	switch( major)
	{
		case DEVMAJOR_LCD:
			

		
			if( minor == 1)
			{
				if(sington_lcd == NULL)
					sington_lcd = SUPER_PTR(lcd_fm12864_new(), dev_lcd);
			
				*dev = sington_lcd;
			}
			else
			{
				
				ret = ERR_BAD_PARAMETER;
			}
			break;
		default:
			ret = ERR_BAD_PARAMETER;
			break;
		
		
	}
	
	return ret;
}

ABS_CTOR( dev_lcd)

END_ABS_CTOR
//=========================================================================//
//                                                                         //
//          P R I V A T E   D E F I N I T I O N S                          //
//                                                                         //
//=========================================================================//
/// \name Private Functions
/// \{




